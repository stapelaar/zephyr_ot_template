## CMakeLists.txt
```
cmake_minimum_required(VERSION 3.20.0)
find_package(Zephyr REQUIRED HINTS $ENV{ZEPHYR_BASE})
project(ot_template)

target_include_directories(app PRIVATE ${CMAKE_CURRENT_SOURCE_DIR}/lib)
target_sources(app PRIVATE
    src/main.c
    lib/thread_utils.c
    lib/mqtt_utils.c
    lib/sht75.c
    lib/shell_utils.c
	lib/ds18b20.c
)
```

## prj.conf
```kconfig
# General Application Settings
CONFIG_MAIN_STACK_SIZE=2560
CONFIG_HEAP_MEM_POOL_SIZE=4096

# Networking
CONFIG_NETWORKING=y
CONFIG_NET_IPV6=y
CONFIG_NET_TCP=y
CONFIG_NET_SOCKETS=y
CONFIG_NET_L2_OPENTHREAD=y
CONFIG_NET_PKT_RX_COUNT=8
CONFIG_NET_PKT_TX_COUNT=8
CONFIG_NET_BUF_RX_COUNT=16
CONFIG_NET_BUF_TX_COUNT=16
CONFIG_NET_CONTEXT_NET_PKT_POOL=y

# MQTT
CONFIG_MQTT_LIB=y
CONFIG_MQTT_LIB_TLS=n
CONFIG_MQTT_LOG_LEVEL_INF=y

# Logging and Console
CONFIG_LOG=y
CONFIG_LOG_MODE_IMMEDIATE=y
CONFIG_LOG_DEFAULT_LEVEL=3
CONFIG_CONSOLE=y
CONFIG_SHELL=y
CONFIG_UART_CONSOLE=y
CONFIG_OPENTHREAD_SHELL=y

# POSIX and LibC
CONFIG_POSIX_API=y
CONFIG_NEWLIB_LIBC=y

# Flash & Persistent Storage
CONFIG_FLASH=y
CONFIG_FLASH_MAP=y
CONFIG_NVS=y
CONFIG_SETTINGS=y
CONFIG_SETTINGS_NVS=y

# GPIO
CONFIG_GPIO=y

CONFIG_W1=y
```

## overlay-OT-0x2410-mtd.conf
```kconfig
# Thread Network Configuration
CONFIG_OPENTHREAD_PANID=9232
CONFIG_OPENTHREAD_CHANNEL=15
CONFIG_OPENTHREAD_NETWORK_NAME="OT-MANNAH"
CONFIG_OPENTHREAD_XPANID="12:34:56:78:12:34:56:78"
CONFIG_OPENTHREAD_NETWORKKEY="6ac256fa944dd28b7f9a641d8449edd9"

# Device Type
CONFIG_OPENTHREAD_MTD=y
CONFIG_OPENTHREAD_MAX_IP_ADDR_PER_CHILD=6

# OpenThread Features
CONFIG_OPENTHREAD_SLAAC=y
CONFIG_OPENTHREAD_PING_SENDER=y
CONFIG_OPENTHREAD_DNS_CLIENT=y
CONFIG_OPENTHREAD_MLR=y
CONFIG_OPENTHREAD_JOINER=y
CONFIG_OPENTHREAD_THREAD_VERSION_1_3=y

# Thread Radio & Platform Info
CONFIG_OPENTHREAD_CONFIG_PLATFORM_INFO="Zephyr"
CONFIG_OPENTHREAD_RADIO_LINK_IEEE_802_15_4_ENABLE=y

# CSL Parameters
CONFIG_OPENTHREAD_CSL_REQUEST_TIME_AHEAD=2000
CONFIG_OPENTHREAD_CSL_RECEIVE_TIME_AHEAD=5000
CONFIG_OPENTHREAD_MIN_RECEIVE_ON_AHEAD=192
CONFIG_OPENTHREAD_MIN_RECEIVE_ON_AFTER=5504
CONFIG_OPENTHREAD_PLATFORM_CSL_UNCERT=255
CONFIG_OPENTHREAD_CSL_TIMEOUT=100

# TX/RX Power Config
CONFIG_OPENTHREAD_DEFAULT_RX_SENSITIVITY=-100
CONFIG_OPENTHREAD_DEFAULT_TX_POWER=0

# BLE TCAT (optional)
CONFIG_OPENTHREAD_BLE_TCAT_THREAD_STACK_SIZE=4200
CONFIG_OPENTHREAD_BLE_TCAT_RING_BUF_SIZE=512

# Frame & Child Supervision
CONFIG_OPENTHREAD_STORE_FRAME_COUNTER_AHEAD=100000
CONFIG_OPENTHREAD_CHILD_SUPERVISION_CHECK_TIMEOUT=190
CONFIG_OPENTHREAD_CHILD_SUPERVISION_INTERVAL=129
CONFIG_OPENTHREAD_MLE_CHILD_TIMEOUT=240
```

## boards/xiao_ble.overlay
```dts
/ {
    aliases {
        onewire0 = &ow0;
    };
};

&gpio1 {
    ow0: onewire {
        compatible = "w1-gpio";
        status = "okay";
        gpios = <&gpio1 15 GPIO_ACTIVE_HIGH>;
        label = "1wire";
    };
};
```

## src/main.c
```c
/*
 * ot_template - OpenThread Sensor Node Template
 * ---------------------------------------------
 * Hardware: Seeed XIAO BLE (nRF52840)
 * Sensors:
 *   - Sensirion SHT-75 (temp/humidity) on D8/P1.13 (SCK), D9/P1.14 (DATA)
 *   - DS18B20 (1-Wire) on D10/P1.15
 * Software: Zephyr RTOS 4.1.99, OpenThread MTD, MQTT over Thread
 * Version: 3.0 - 2025-04-21
 */

/* ========================================================================== */

#include <zephyr/logging/log.h>
#include <zephyr/kernel.h>
#include <stdio.h>
#include "thread_utils.h"
#include "mqtt_utils.h"
#include "shell_utils.h"
#include "sht75.h"
#include "ds18b20.h"

LOG_MODULE_REGISTER(main, LOG_LEVEL_INF);

#define USE_SHT75_SENSOR 0
#define USE_DS18B20_SENSOR 1

#define NODE_ID        "ot_node_template_2"
#define MQTT_USERNAME  "ot_node_template_2"
#define MQTT_PASSWORD  "ot_node_template_2"
#define MQTT_TOPIC_TEMP   NODE_ID "-out/temp"
#define MQTT_TOPIC_HUMID  NODE_ID "-out/humidity"
#define POLL_INTERVAL_MS  300000 // 5 minuten (300s)

#if USE_SHT75_SENSOR
static const struct sht75_config sht75_cfg = {
    .gpio_dev = DEVICE_DT_GET(DT_NODELABEL(gpio1)),
    .sck_pin = 13,
    .data_pin = 14
};
#endif

#if USE_DS18B20_SENSOR
#define DS18B20_DATA_PIN 15
static const struct ds18b20_config ds_cfg = {
    .gpio_dev = DEVICE_DT_GET(DT_NODELABEL(gpio1)),
    .data_pin = DS18B20_DATA_PIN
};
static struct ds18b20_rom sensors[DS18B20_MAX_SENSORS];
static int sensor_count = 0;
#endif

static struct mqtt_client client;

int main(void)
{
    LOG_INF("Starting Sensor Node...");

#if USE_SHT75_SENSOR
    if (sht75_init(&sht75_cfg) != 0) {
        LOG_WRN("SHT-75 init failed — continuing without it");
    }
#endif


#if USE_DS18B20_SENSOR
    if (ds18b20_init(&ds_cfg) != 0) {
        LOG_ERR("DS18B20 init failed");
        return -1;
    }
    sensor_count = ds18b20_scan(&ds_cfg, sensors, DS18B20_MAX_SENSORS);
    LOG_INF("Found %d DS18B20 sensor(s)", sensor_count);
    if (sensor_count == 0) {
        LOG_WRN("No DS18B20 sensors found");
    }
#endif

    if (thread_init() != 0) {
        LOG_ERR("Thread init failed");
        return -1;
    }

    shell_utils_init();
    mqtt_utils_set_credentials(NODE_ID, MQTT_USERNAME, MQTT_PASSWORD);

    LOG_INF("Waiting 10s for network...");
    k_sleep(K_SECONDS(10));

    while (1) {
        if (mqtt_utils_connect(&client) != 0) {
            LOG_ERR("Connect failed, retrying...");
            k_sleep(K_SECONDS(10));
            continue;
        }

        while (1) {
#if USE_SHT75_SENSOR
            struct sht75_data sht75_data;
            if (sht75_read(&sht75_cfg, &sht75_data) == 0) {
                char temp_str[16], humid_str[16];
                snprintf(temp_str, sizeof(temp_str), "%.2f", (double)sht75_data.temperature);
                snprintf(humid_str, sizeof(humid_str), "%.2f", (double)sht75_data.humidity);
                mqtt_utils_publish(&client, MQTT_TOPIC_TEMP, temp_str);
                mqtt_utils_publish(&client, MQTT_TOPIC_HUMID, humid_str);
            } else {
                LOG_ERR("SHT-75 read failed");
                break;
            }
#endif

#if USE_DS18B20_SENSOR
            for (int i = 0; i < sensor_count; i++) {
                float temp;
                if (ds18b20_read_temp(&ds_cfg, &sensors[i], &temp) == 0) {
                    char topic[64];
                    char payload[16];
                    snprintf(payload, sizeof(payload), "%.2f", (double)temp);
                    snprintf(topic, sizeof(topic),"%s/ds18b20_%d/temp", NODE_ID, i);

                    mqtt_utils_publish(&client, topic, payload);
                } else {
                    LOG_ERR("DS18B20 read failed for sensor %d", i);
                }
            }
#endif

            k_sleep(K_MSEC(POLL_INTERVAL_MS - 5000)); // 295s slaap
            if (mqtt_utils_keepalive(&client) != 0) {
                LOG_ERR("Keepalive failed");
                break;
            }

            k_sleep(K_MSEC(5000)); // 5s na keepalive
        }

        mqtt_utils_disconnect(&client);
        k_sleep(K_SECONDS(5));
    }

    return 0;
}
```
